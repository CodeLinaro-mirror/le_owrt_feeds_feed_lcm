## apps/cthulhu/Config.in
```kconfig
config PACKAGE_cthulhu
    tristate
    select SAH_SERVICES_CTHULHU

if PACKAGE_cthulhu

menu "Select cthulhu build options"
    depends on PACKAGE_cthulhu

config SAH_SERVICES_CTHULHU
    bool "Build Cthulhu"
    default y
    select USE_FS_ACL_ATTR

config SAH_SERVICES_CTHULHU_INIT_START
    int "Cthulhu plugin start up order"
    default 99

config SAH_SERVICES_CTHULHU_INIT_STOP
    int "Cthulhu plugin stop order"
    default 60

config SAH_SERVICES_CTHULHU_PROCD_SUPPORT
    bool "Installs procd init script in stead of the default init script"
    default PACKAGE_procd

endmenu

endif
```

## apps/rlyeh/Config.in
```kconfig
config PACKAGE_rlyeh
    tristate
    select SAH_SERVICES_RLYEH

if PACKAGE_rlyeh

menu "Select rlyeh build options"
    depends on PACKAGE_rlyeh

config SAH_SERVICES_RLYEH
    bool "Build Rlyeh"
    default y

config SAH_SERVICES_RLYEH_ORDER
    int "Rlyeh plugin start up order"
    default 90

config SAH_SERVICES_RLYEH_PROCD_SUPPORT
    bool "Installs procd init script in stead of the default init script"
    default PACKAGE_procd

endmenu

endif
```

## plugins/cthulhu/cthulhu-plugin-usp/Config.in
```kconfig
config PACKAGE_cthulhu-plugin-usp
    tristate
    select SAH_PLUGIN_CTHULHU_USP

if PACKAGE_cthulhu-plugin-usp

menu "Select cthulhu-plugin-usp build options"
    depends on PACKAGE_cthulhu-plugin-usp

config SAH_PLUGIN_CTHULHU_USP
    bool "Build Cthulhu USP plugin"
    default n

config PLUGIN_USP_PASSWORD_LENGTH
    int "Length of the generated password for USP services, must be between 32 and 248"
    default 32

endmenu

endif
```
